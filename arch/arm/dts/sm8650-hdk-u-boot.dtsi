/ {
/*
RAM Entry 0   : Base 0x0080000000  Size 0x0001200000
RAM Entry 1   : Base 0x00816E0000  Size 0x0000EC0000
RAM Entry 2   : Base 0x00D8040000  Size 0x0000020000
RAM Entry 3   : Base 0x00D8800000  Size 0x0000000000
RAM Entry 4   : Base 0x00E1BB0000  Size 0x001E450000
RAM Entry 5   : Base 0x0880000000  Size 0x002F900000
RAM Entry 6   : Base 0x08B0000000  Size 0x000A300000
RAM Entry 7   : Base 0x0980000000  Size 0x0180000000
RAM Entry 8   : Base 0x08C0000000  Size 0x00C0000000
RAM Entry 9   : Base 0x0082600000  Size 0x0055A00000
*/
	memory@a0000000 {
		reg = <0x00 0x80000000 0x00 0x01200000>,
		<0x00 0x816E0000 0x00 0x00EC0000>,
		<0x00 0xD8040000 0x00 0x00020000>,
		<0x00 0xD8800000 0x00 0x00000000>,
		<0x00 0xE1BB0000 0x00 0x1E450000>,
		<0x08 0x80000000 0x00 0x2F900000>,
		<0x08 0xB0000000 0x00 0x0A300000>,
		<0x09 0x80000000 0x01 0x80000000>,
		<0x08 0xC0000000 0x00 0xC0000000>,
		<0x00 0x82600000 0x00 0x55A00000>;
	};
};