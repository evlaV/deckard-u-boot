## arch/arm/mach-snapdragon/Kconfig
```kconfig
if ARCH_SNAPDRAGON

config SYS_SOC
	default "snapdragon"

config SYS_VENDOR
	string "Snapdragon board vendor"
	default "qualcomm"
	help
	  Allows to specify vendor for the Snapdragon SoCs based boards.
	  Based on this option board/<CONFIG_SYS_VENDOR>/<CONFIG_SYS_BOARD>
	  will be used as the custom board directory.

config SYS_MALLOC_LEN
	default 0x10000000

config SYS_MALLOC_F_LEN
	default 0x20000

config SPL_SYS_MALLOC_F
	default y

config SPL_SYS_MALLOC_F_LEN
	default 0x800000

config SYS_MALLOC_LEN
	default 0x800000

config LNX_KRNL_IMG_TEXT_OFFSET_BASE
	default 0x80000000

config SYS_BOARD
	string "Snapdragon SoCs based board"
	help
	  Allows to specify the Snapdragon SoCs based board name.
	  Based on this option board/<CONFIG_SYS_VENDOR>/<CONFIG_SYS_BOARD>
	  will be used as the custom board directory.

config SYS_CONFIG_NAME
	string "Board configuration name"
	default SYS_BOARD if SYS_BOARD != ""
	default "qcom"
	help
	  This option contains information about board configuration name.
	  Based on this option include/configs/<CONFIG_SYS_CONFIG_NAME>.h header
	  will be used for board configuration.

config SNAPDRAGON_SPL
	bool "Add support for an SPL stage on Snapdragon SoCs"
	select SUPPORT_SPL
	select FIT
	select SPL_LOAD_FIT
	select SPL_SHOW_ERRORS
	select SPL_ENV_SUPPORT
	imply SPL
	imply SPL_DM
	imply SPL_LIBCOMMON_SUPPORT
	imply SPL_LIBGENERIC_SUPPORT
	imply SPL_OF_CONTROL
	imply SPL_BOARD_INIT
	imply SPL_DM_SERIAL
	imply SPL_SERIAL
	imply SPL_LOG
	imply SPL_RAM_SUPPORT
	imply SPL_FIT

config SPL_BSS_START_ADDR
	default 0xa7100000 if SNAPDRAGON_SPL

config SPL_BSS_MAX_SIZE
	default 0x8000 if SNAPDRAGON_SPL

endif
```

## board/qualcomm/sm8250-hdk/Kconfig
```kconfig
if TARGET_SM8250_HDK

config SYS_BOARD
	default "sm8250-hdk"

config SYS_CONFIG_NAME
	default "sm8250-hdk"

config SYS_VENDOR
	default "qualcomm"

endif
```

## board/qualcomm/sm8550-hdk/Kconfig
```kconfig
if TARGET_SM8550_HDK

config SYS_BOARD
	default "sm8550-hdk"

config SYS_CONFIG_NAME
	default "sm8550-hdk"

config SYS_VENDOR
	default "qualcomm"

endif
```

## board/qualcomm/sm8650-hdk/Kconfig
```kconfig
if TARGET_SM8650_HDK

config SYS_BOARD
	default "sm8650-hdk"

config SYS_CONFIG_NAME
	default "sm8650-hdk"

config SYS_VENDOR
	default "qualcomm"

endif
```

## board/qualcomm/sm8650/Kconfig
```kconfig
if TARGET_SM8650

config SYS_BOARD
	default "sm8650"

config SYS_CONFIG_NAME
	default "sm8650"

config SYS_VENDOR
	default "qualcomm"

endif
```

## configs/sandbox64_ccf_full_defconfig
```kconfig
#include "sandbox64_defconfig"

CONFIG_ARCH_SANDBOX=y
CONFIG_CLK_CCF_FULL=y
CONFIG_CLK_CCF_FULL_COMPAT=y
```

## configs/sm8650-el2-hdk_defconfig
```kconfig
CONFIG_ARM=y
CONFIG_SKIP_LOWLEVEL_INIT=y
CONFIG_POSITION_INDEPENDENT=y
CONFIG_SYS_INIT_SP_BSS_OFFSET=983040
CONFIG_ARCH_SNAPDRAGON=y
CONFIG_SYS_MALLOC_LEN=0x20000000
CONFIG_SYS_MALLOC_F_LEN=0x2000
CONFIG_NR_DRAM_BANKS=8
CONFIG_DEFAULT_DEVICE_TREE="sm8650-el2-hdk"
CONFIG_SYS_LOAD_ADDR=0xa7000000
CONFIG_PCI=y
CONFIG_BUTTON_CMD=y
CONFIG_FIT=y
CONFIG_FIT_VERBOSE=y
CONFIG_BOOTSTD_FULL=y
# CONFIG_BOOTMETH_VBE is not set
CONFIG_BOOTDELAY=1
CONFIG_OF_BOARD_SETUP=y
CONFIG_BOOTCOMMAND=""
CONFIG_USE_PREBOOT=y
CONFIG_SAVE_PREV_BL_INITRAMFS_START_ADDR=y
CONFIG_SYS_CBSIZE=512
CONFIG_SYS_BOOTM_LEN=0x8000000
CONFIG_LOG_MAX_LEVEL=9
CONFIG_LOG_DEFAULT_LEVEL=4
# CONFIG_DISPLAY_CPUINFO is not set
CONFIG_DISPLAY_BOARDINFO_LATE=y
CONFIG_CMD_BOOTMENU=y
CONFIG_CMD_EEPROM=y
CONFIG_SYS_I2C_EEPROM_BUS=2
CONFIG_SYS_I2C_EEPROM_ADDR_LEN=2
CONFIG_SYS_EEPROM_PAGE_WRITE_BITS=5
# CONFIG_CMD_BIND is not set
CONFIG_CMD_CLK=y
CONFIG_CMD_GPIO=y
CONFIG_CMD_I2C=y
CONFIG_CMD_MMC=y
CONFIG_CMD_PCI=y
CONFIG_CMD_UFS=y
CONFIG_CMD_USB_MASS_STORAGE=y
CONFIG_CMD_CAT=y
CONFIG_CMD_CACHE=y
CONFIG_CMD_RNG=y
CONFIG_CMD_REGULATOR=y
CONFIG_CMD_LOG=y
CONFIG_OF_LIVE=y
# CONFIG_OF_UPSTREAM is not set
CONFIG_ENV_IS_IN_EXT4=y
CONFIG_ENV_EXT4_INTERFACE="scsi"
CONFIG_ENV_EXT4_DEVICE_AND_PART="1:B"
CONFIG_BUTTON_QCOM_PMIC=y
CONFIG_CLK=y
CONFIG_CLK_STUB=y
CONFIG_CLK_QCOM_SM8650=y
CONFIG_USB_FUNCTION_FASTBOOT=y
CONFIG_FASTBOOT_BUF_ADDR=0
CONFIG_FASTBOOT_BUF_SIZE=0x10000000
CONFIG_MSM_GPIO=y
CONFIG_QCOM_PMIC_GPIO=y
CONFIG_DM_I2C=y
CONFIG_SYS_I2C_GENI=y
CONFIG_I2C_MUX=y
CONFIG_DM_KEYBOARD=y
CONFIG_BUTTON_KEYBOARD=y
CONFIG_MISC=y
CONFIG_NVMEM=y
CONFIG_I2C_EEPROM=y
CONFIG_MMC_HS200_SUPPORT=y
CONFIG_MMC_SDHCI=y
CONFIG_MMC_SDHCI_ADMA=y
CONFIG_MMC_SDHCI_MSM=y
CONFIG_NVME_PCI=y
CONFIG_PCIE_DW_QCOM=y
CONFIG_PHY=y
CONFIG_PHY_QCOM_QMP_PCIE=y
CONFIG_PHY_QCOM_QMP_UFS=y
CONFIG_PHY_QCOM_QMP_COMBO=y
CONFIG_PHY_QCOM_SNPS_EUSB2=y
CONFIG_PINCTRL=y
CONFIG_PINCONF=y
CONFIG_PINCTRL_QCOM_SM8650=y
CONFIG_DM_PMIC=y
CONFIG_PMIC_QCOM=y
CONFIG_DM_REGULATOR=y
CONFIG_DM_REGULATOR_FIXED=y
CONFIG_DM_REGULATOR_GPIO=y
CONFIG_DM_REGULATOR_QCOM_RPMH=y
CONFIG_DM_RNG=y
CONFIG_RNG_MSM=y
CONFIG_SCSI=y
CONFIG_MSM_SERIAL=y
CONFIG_MSM_GENI_SERIAL=y
CONFIG_SOC_QCOM=y
CONFIG_QCOM_COMMAND_DB=y
CONFIG_QCOM_RPMH=y
CONFIG_QCOM_SMEM=y
CONFIG_SPMI_MSM=y
CONFIG_SYSINFO=y
CONFIG_SYSINFO_SMBIOS=y
CONFIG_USB=y
CONFIG_DM_USB_GADGET=y
CONFIG_USB_DWC3=y
CONFIG_USB_DWC3_GENERIC=y
CONFIG_USB_GADGET=y
CONFIG_USB_GADGET_VENDOR_NUM=0x1b8e
CONFIG_USB_GADGET_PRODUCT_NUM=0xfada
CONFIG_UFS=y
CONFIG_QCOM_UFS=y
```

## drivers/clk/ccf/Kconfig
```kconfig
config CLK_CCF_FULL
	bool "Full Common Clock Framework [CCF] support"
	depends on CLK && !CLK_CCF
	help
	  Enable this option if you want to use the full Linux kernel's Common
	  Clock Framework [CCF] code in U-Boot. This is a full API compatible
	  port as opposed to U-Boot "uCCF", drivers must register clocks at
	  runtime and should not use UCLASS_CLK.
```

## drivers/clk/uccf/Kconfig
```kconfig
config SPL_CLK_CCF
	bool "SPL U-Boot Common Clock Framework [uCCF] support"
	depends on SPL
	help
	  Enable this option if you want to (re-)use the Linux kernel's Common
	  Clock Framework [CCF] code in U-Boot's SPL.

config SPL_CLK_COMPOSITE_CCF
	bool "SPL U-Boot Common Clock Framework [uCCF] composite clk support"
	depends on SPL_CLK_CCF
	help
	  Enable this option if you want to (re-)use the Linux kernel's Common
	  Clock Framework [CCF] composite code in U-Boot's SPL.

config CLK_CCF
	bool "U-Boot Common Clock Framework [uCCF] support"
	help
	  Enable this option if you want to (re-)use the Linux kernel's Common
	  Clock Framework [CCF] code in U-Boot's clock driver.
```

## drivers/video/qcom/Kconfig
```kconfig
# SPDX-License-Identifier: GPL-2.0+
#
# Copyright (C) 2025 Linaro.Ltd
#
# Author: Jun Nie <jun.nie@linaro.org>

config VIDEO_QCOM
	bool "Enable Qualcomm video support"
	depends on VIDEO && VIDEO_MIPI_DSI && VIDEO_BRIDGE && ARCH_SNAPDRAGON
	select DISPLAY
	help
	  Enable Qualcomm Video Processing Unit video support.

config PHY_QCOM_MIPI_DSI
	tristate "Qualcomm MIPI DSI PHY driver"
	depends on PHY && VIDEO_QCOM
	help
	  Enable this to support the MIPI DSI PHY on various on Qualcomm
	  chipsets.
```

## fs/gpt/Kconfig
```kconfig
config SPL_FS_GPT
	bool "SPL FS GPT Support"
	help
	  GPT partition handling within SPL
	  If you don't want to enable compression feature, say N.
```
